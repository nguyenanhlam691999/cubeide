# file: homework_pwm1.ioc
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Mcu.Family=STM32F1
Mcu.Name=STM32F103C(8-B)Tx
Mcu.Package=LQFP48
NVIC.PriorityGroup=NVIC_PRIORITYGROUP_4
PA13.Mode=Serial_Wire
PA13.Signal=SYS_JTMS-SWDIO
PA14.Mode=Serial_Wire
PA14.Signal=SYS_JTCK-SWCLK
ProjectManager.HeapSize=0x200
ProjectManager.StackSize=0x400
ProjectManager.TargetToolchain=STM32CubeIDE
RCC.APB1Freq_Value=8000000
RCC.APB2Freq_Value=8000000
board=custom

// file: Core/Src/main.c
/* USER CODE BEGIN Header */
/**
 ******************************************************************************
 * @file           : main.c
 * @brief          : Main program body
 ******************************************************************************
 * @attention
 *
 * <h2><center>&copy; Copyright (c) 2021 STMicroelectronics.
 * All rights reserved.</center></h2>
 *
 * This software component is licensed by ST under BSD 3-Clause license,
 * the "License"; You may not use this file except in compliance with the
 * License. You may obtain a copy of the License at:
 *                        opensource.org/licenses/BSD-3-Clause
 *
 ******************************************************************************
 */
/* USER CODE END Header */
#include "main.h"

void SystemClock_Config(void);
static void MX_GPIO_Init(void);

/* USER CODE BEGIN 0 */
typedef struct {
	uint32_t CRL;
	uint32_t CRH;
	uint32_t IDR;
	uint32_t ODR;

} GPIO_t;
typedef struct {
	uint32_t IMR;
	uint32_t EMR;
	uint32_t RTSR;
	uint32_t FTSR;
	uint32_t SWIER;
	uint32_t PR;
} EXTI_t;
typedef struct {
	uint32_t CR;
	uint32_t CFGR;
	uint32_t CIR;
	uint32_t APB2RSTR;
	uint32_t APB1RSTR;
	uint32_t AHBENR;
	uint32_t APB2ENR;
	uint32_t APB1ENR;
	uint32_t BDCR;
	uint32_t CSR;

} RCC_t;
RCC_t *MY_RCC = 0x40021000;
GPIO_t *MY_GPIO_B = 0x40010c00;
GPIO_t *MY_GPIO_A = 0x40010800;
uint32_t *TIMER1_SR = (uint32_t*) 0x40012C10;
uint32_t *AFIO_EVCR = 0x40010000;
uint32_t *TIMER1_CCR = 0x40012c34;
int counter = 0;
void MY_RCC_INIT(char *mode) {
	if (strcmp(mode, "PLL") == 0) {
		MY_RCC->CFGR &= ~(0xf << 18);
		MY_RCC->CFGR |= (0b0110 << 18);
		MY_RCC->CFGR |= 0b10;
		MY_RCC->CFGR |= (0b0100 << 24);
		MY_RCC->CR |= (1 << 24);
	}
	if (strcmp(mode, "HSI") == 0) {
		MY_RCC->CFGR |= (0b00);
		MY_RCC->CR |= (1 << 0);
	}
}

void MY_TIMER1_INIT() {
	// 1000 times in 1 millis
	// TIMER1 : 40012C00
	uint32_t *TIMER1_PSC = (uint32_t*) 0x40012C28;
	uint32_t *TIMER1_SR = (uint32_t*) 0x40012C10;
	uint32_t *TIMER_ARR = (uint32_t*) 0x40012C2C;
	uint32_t *TIMER1_EGR = 0x40012c14;
	uint32_t *TIMER1_DIER = 0x40012c0c;

	uint32_t *TIMER1_CCMR1 = 0x40012c18;
	uint32_t *TIMER1_CCER = 0x40012c20;
	uint32_t *TIMER1_BDTR = 0x40012c44;
	uint32_t *TIMER1_CR1 = 0x40012c00;
	// SET PRE-SCALER PSC 0x28
	*TIMER1_PSC = 7;
	// SET AUTO-RELOAD ARR 0x2C
	*TIMER_ARR &= ~(0xffff);
	*TIMER_ARR = 1000;
	// SET update generration
	*TIMER1_EGR |= (0b1);
	// SET UPDATE INTERRUPT ENABLE
	*TIMER1_DIER |= (0b1);
	/*// Set TIMx_CCRx
	*TIMER1_CCR = 0;
	// Set Output Compare mode
	*TIMER1_CCMR1 &= ~(0b111 << 4);
	*TIMER1_CCMR1 |= (0b110 << 4);
	// Enable pre-load
	*TIMER1_CCMR1 |= (0b1 << 2);
	// Enable output fast mode
	*TIMER1_CCMR1 |= (0b1 << 3);
	// Enable Capture/Compare output
	*TIMER1_CCER |= (0b1);
	*TIMER1_BDTR |= (0b1 << 15);
	uint32_t *TIMER1_CNT = 0x40012c24;
	// the auto-reload preload register
	*TIMER1_CR1 |= (0b1 << 7);*/
	// ENABLE TIMER1 BY SET CEN ON CR1
	*TIMER1_CR1 |= 0b1;
	// WAIT UIF IS SET
	while ((*TIMER1_SR & 1) != 1)
		;
}
void GPIO_PWM_OUTPUT() {
	// Alternate function push-pull
	// GPIO A8
	MY_GPIO_B->CRH &= ~(0b1111);
	MY_GPIO_B->CRH |= (0b1011);

	*AFIO_EVCR &= ~0xf;
	*AFIO_EVCR |= 0b1000;
}
void MY_DELAY(uint32_t millis) {
	counter = 0;
	while (counter < millis) {
		asm("NOP");
	}

}
void LED_BLINK() {
// SET GPIO OUTPUT
	MY_GPIO_B->CRL &= ~(0xf);
	MY_GPIO_B->CRL |= (0b001100110011);
	MY_GPIO_B->ODR |= 0xffff;
	for (int var = 0; (var < 3); ++var) {
		MY_GPIO_B->ODR &= ~(1 << var);
		//HAL_Delay(100);
		MY_DELAY(100);
		//SET LED OFF
		MY_GPIO_B->ODR |= (1 << var);
		//HAL_Delay(100);
		MY_DELAY(100);
	}
}
void TIM1_UP_IRQHandler() {
	uint32_t *TIMER1_SR = (uint32_t*) 0x40012C10;
	counter++;
	*TIMER1_SR &= ~0b1;
}
/* USER CODE END 0 */

int main(void) {

	/* MCU Configuration--------------------------------------------------------*/

	/* Reset of all peripherals, Initializes the Flash interface and the Systick. */
	//HAL_Init();

	/* Configure the system clock */
	//SystemClock_Config();

	/* Initialize all configured peripherals */
	//MX_GPIO_Init();
	/* USER CODE BEGIN 2 */
	MY_RCC_INIT("HSI");
	// ENABLE CLOCK TIMER1
	MY_RCC->APB2ENR |= (0b1 << 11);
	MY_RCC->APB2ENR |= (0b1 << 3) | (0b1 << 2) | (0b1);
	//__HAL_RCC_GPIOB_CLK_ENABLE();
	//__HAL_RCC_TIM1_CLK_ENABLE();
	MY_TIMER1_INIT();
	NVIC_EnableIRQ(TIM1_UP_IRQn);
	GPIO_PWM_OUTPUT();
	/* USER CODE END 2 */

	/* Infinite loop */
	while (1) {

		/* USER CODE BEGIN 3 */
		LED_BLINK();

		/* USER CODE END 3 */
	}
}

	/**
	 * @brief System Clock Configuration
	 * @retval None
	 */
	void SystemClock_Config(void) {
		RCC_OscInitTypeDef RCC_OscInitStruct = { 0 };
		RCC_ClkInitTypeDef RCC_ClkInitStruct = { 0 };

		/** Initializes the RCC Oscillators according to the specified parameters
		 * in the RCC_OscInitTypeDef structure.
		 */
		RCC_OscInitStruct.OscillatorType = RCC_OSCILLATORTYPE_HSI;
		RCC_OscInitStruct.HSIState = RCC_HSI_ON;
		RCC_OscInitStruct.HSICalibrationValue = RCC_HSICALIBRATION_DEFAULT;
		RCC_OscInitStruct.PLL.PLLState = RCC_PLL_NONE;
		if (HAL_RCC_OscConfig(&RCC_OscInitStruct) != HAL_OK) {
			Error_Handler();
		}
		/** Initializes the CPU, AHB and APB buses clocks
		 */
		RCC_ClkInitStruct.ClockType = RCC_CLOCKTYPE_HCLK | RCC_CLOCKTYPE_SYSCLK
				| RCC_CLOCKTYPE_PCLK1 | RCC_CLOCKTYPE_PCLK2;
		RCC_ClkInitStruct.SYSCLKSource = RCC_SYSCLKSOURCE_HSI;
		RCC_ClkInitStruct.AHBCLKDivider = RCC_SYSCLK_DIV1;
		RCC_ClkInitStruct.APB1CLKDivider = RCC_HCLK_DIV1;
		RCC_ClkInitStruct.APB2CLKDivider = RCC_HCLK_DIV1;

		if (HAL_RCC_ClockConfig(&RCC_ClkInitStruct, FLASH_LATENCY_0)
				!= HAL_OK) {
			Error_Handler();
		}
	}

	/**
	 * @brief GPIO Initialization Function
	 * @param None
	 * @retval None
	 */
	static void MX_GPIO_Init(void) {

		/* GPIO Ports Clock Enable */
		__HAL_RCC_GPIOA_CLK_ENABLE();

	}

	/**
	 * @brief  This function is executed in case of error occurrence.
	 * @retval None
	 */
	void Error_Handler(void) {
		__disable_irq();
		while (1) {
		}
	}

	/************************ (C) COPYRIGHT STMicroelectronics *****END OF FILE****/

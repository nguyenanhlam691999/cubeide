# file: homework_rcc.ioc
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Mcu.Family=STM32F1
Mcu.Name=STM32F103C(8-B)Tx
Mcu.Package=LQFP48
NVIC.PriorityGroup=NVIC_PRIORITYGROUP_4
PA13.Mode=Serial_Wire
PA13.Signal=SYS_JTMS-SWDIO
PA14.Mode=Serial_Wire
PA14.Signal=SYS_JTCK-SWCLK
ProjectManager.HeapSize=0x200
ProjectManager.StackSize=0x400
ProjectManager.TargetToolchain=STM32CubeIDE
RCC.APB1Freq_Value=8000000
RCC.APB2Freq_Value=8000000
board=custom

// file: Core/Src/main.c
/* USER CODE BEGIN Header */
/**
 ******************************************************************************
 * @file           : main.c
 * @brief          : Main program body
 ******************************************************************************
 * @attention
 *
 * <h2><center>&copy; Copyright (c) 2021 STMicroelectronics.
 * All rights reserved.</center></h2>
 *
 * This software component is licensed by ST under BSD 3-Clause license,
 * the "License"; You may not use this file except in compliance with the
 * License. You may obtain a copy of the License at:
 *                        opensource.org/licenses/BSD-3-Clause
 *
 ******************************************************************************
 */
/* USER CODE END Header */
#include "main.h"
#include "my_define.h"
#include"string.h"

void SystemClock_Config(void);
static void MX_GPIO_Init(void);

/* USER CODE BEGIN 0 */

RCC_t *MY_RCC = 0x40021000;
GPIO_t *MY_GPIO_B = 0x40010c00;
void MY_RCC_INIT(char *mode) {
	if (strcmp(mode, "PLL") == 0) {
		MY_RCC->CFGR &= ~(0xf << 18);
		MY_RCC->CFGR |= (0b0110 << 18);
		MY_RCC->CFGR |= 0b10;
		MY_RCC->CFGR |= (0b0100 << 24);
		MY_RCC->CR |= (1 << 24);
	}
	if (strcmp(mode, "HSI") == 0) {
		MY_RCC->CFGR |= (0b00);
		MY_RCC->CR |= (1 << 0);

	}

}
void MY_RCC_CLOCK_ENABLE() {
	// ENABLE CLOCK PORT B
	MY_RCC->APB2ENR |= (1 << 3);

}
void LED_BLINK() {
	// SET GPIO OUTPUT
	MY_GPIO_B->CRL &= ~(0xf);
	MY_GPIO_B->CRL |= (0b001100110011);
	HAL_Delay(1000);
	MY_GPIO_B->ODR |= 0xffff;
	HAL_Delay(500);
	char chieu = 0;
	for (int var = 0; (var < 3) && (chieu == 0); ++var) {
		MY_GPIO_B->ODR &= ~(1 << var);
		HAL_Delay(500);
		//SET LED OFF
		MY_GPIO_B->ODR |= (1 << var);
		HAL_Delay(500);
		if (var == 2) {
			chieu = 1;
		}
	}
	for (int varr = 2; (chieu == 1); --varr) {
		MY_GPIO_B->ODR &= ~(1 << varr);
		HAL_Delay(500);
		//SET LED OFF
		MY_GPIO_B->ODR |= (1 << varr);
		HAL_Delay(500);
		if (varr == 0) {
			chieu = 0;
		}

	}

}
/* USER CODE END 0 */

int main(void) {

	/* MCU Configuration--------------------------------------------------------*/

	/* Reset of all peripherals, Initializes the Flash interface and the Systick. */
	HAL_Init();

	/* Configure the system clock */
	//SystemClock_Config();

	/* Initialize all configured peripherals */

	/* USER CODE BEGIN 2 */
	MY_RCC_INIT("HSI");
	MY_RCC_CLOCK_ENABLE();
	LED_BLINK();
	/* USER CODE END 2 */

	/* Infinite loop */
	while (1) {

		/* USER CODE BEGIN 3 */
		LED_BLINK();

	}
	/* USER CODE END 3 */
}

void SystemClock_Config(void) {
	RCC_OscInitTypeDef RCC_OscInitStruct = { 0 };
	RCC_ClkInitTypeDef RCC_ClkInitStruct = { 0 };

	/** Initializes the RCC Oscillators according to the specified parameters
	 * in the RCC_OscInitTypeDef structure.
	 */
	RCC_OscInitStruct.OscillatorType = RCC_OSCILLATORTYPE_HSI;
	RCC_OscInitStruct.HSIState = RCC_HSI_ON;
	RCC_OscInitStruct.HSICalibrationValue = RCC_HSICALIBRATION_DEFAULT;
	RCC_OscInitStruct.PLL.PLLState = RCC_PLL_NONE;
	if (HAL_RCC_OscConfig(&RCC_OscInitStruct) != HAL_OK) {
		Error_Handler();
	}
	/** Initializes the CPU, AHB and APB buses clocks
	 */
	RCC_ClkInitStruct.ClockType = RCC_CLOCKTYPE_HCLK | RCC_CLOCKTYPE_SYSCLK
			| RCC_CLOCKTYPE_PCLK1 | RCC_CLOCKTYPE_PCLK2;
	RCC_ClkInitStruct.SYSCLKSource = RCC_SYSCLKSOURCE_HSI;
	RCC_ClkInitStruct.AHBCLKDivider = RCC_SYSCLK_DIV1;
	RCC_ClkInitStruct.APB1CLKDivider = RCC_HCLK_DIV1;
	RCC_ClkInitStruct.APB2CLKDivider = RCC_HCLK_DIV1;

	if (HAL_RCC_ClockConfig(&RCC_ClkInitStruct, FLASH_LATENCY_0) != HAL_OK) {
		Error_Handler();
	}
}

static void MX_GPIO_Init(void) {

	/* GPIO Ports Clock Enable */
	__HAL_RCC_GPIOA_CLK_ENABLE();

}

void Error_Handler(void) {
	__disable_irq();
	while (1) {
	}
}

/************************ (C) COPYRIGHT STMicroelectronics *****END OF FILE****/

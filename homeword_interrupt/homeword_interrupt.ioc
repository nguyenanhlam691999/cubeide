# file: homeword_interrupt.ioc
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Mcu.Family=STM32F1
Mcu.Name=STM32F103C(8-B)Tx
Mcu.Package=LQFP48
NVIC.PriorityGroup=NVIC_PRIORITYGROUP_4
PA13.Mode=Serial_Wire
PA13.Signal=SYS_JTMS-SWDIO
PA14.Mode=Serial_Wire
PA14.Signal=SYS_JTCK-SWCLK
ProjectManager.HeapSize=0x200
ProjectManager.StackSize=0x400
ProjectManager.TargetToolchain=STM32CubeIDE
RCC.APB1Freq_Value=8000000
RCC.APB2Freq_Value=8000000
board=custom

// file: Core/Src/main.c
/* USER CODE BEGIN Header */
/**
 ******************************************************************************
 * @file           : main.c
 * @brief          : Main program body
 ******************************************************************************
 * @attention
 *
 * <h2><center>&copy; Copyright (c) 2021 STMicroelectronics.
 * All rights reserved.</center></h2>
 *
 * This software component is licensed by ST under BSD 3-Clause license,
 * the "License"; You may not use this file except in compliance with the
 * License. You may obtain a copy of the License at:
 *                        opensource.org/licenses/BSD-3-Clause
 *
 ******************************************************************************
 */
/* USER CODE END Header */
#include "main.h"

void SystemClock_Config(void);
static void MX_GPIO_Init(void);

/* USER CODE BEGIN 0 */

typedef struct {
	uint32_t CRL;
	uint32_t CRH;
	uint32_t IDR;
	uint32_t ODR;

} GPIO_t;
typedef struct {
	uint32_t IMR;
	uint32_t EMR;
	uint32_t RTSR;
	uint32_t FTSR;
	uint32_t SWIER;
	uint32_t PR;
} EXTI_t;

void delay(uint32_t time);
void my_interrupt();

/* USER CODE END 0 */

int main(void) {

	/* MCU Configuration--------------------------------------------------------*/

	/* Reset of all peripherals, Initializes the Flash interface and the Systick. */
	HAL_Init();

	/* Configure the system clock */
	SystemClock_Config();

	/* Initialize all configured peripherals */
	MX_GPIO_Init();
	/* USER CODE BEGIN 2 */
	__HAL_RCC_GPIOA_CLK_ENABLE();
	__HAL_RCC_GPIOB_CLK_ENABLE();
	__HAL_RCC_AFIO_CLK_ENABLE();
// set port pa11
	GPIO_t *PORTA11 = 0x40010800;
	PORTA11->CRH &= ~(0xffffffff);
	PORTA11->CRH |= (0b1000 << 12);
	PORTA11->ODR |= (0b1 << 11);
// set led output b0
	GPIO_t *PORTB0 = 0x40010C00;
	PORTB0->CRL &= ~(0xffffffff);
	PORTB0->CRL |= (0b00110011);
	PORTB0->ODR |= (0xffff);
	PORTB0->ODR |= (0b11 << 0);
//  set pin interrupt
	uint32_t *AFIO_EXTICR3 = 0x40010010;
	*AFIO_EXTICR3 &= ~(0b1111 << 12);
/// set interrupt mode
	EXTI_t *PORTA11_interrupt = 0x40010400;
	PORTA11_interrupt->IMR |= (1 << 11);
	PORTA11_interrupt->FTSR |= (1 << 11);
// ENABLE NVIC_ISER0
	uint32_t *NVIC_ISER1 = 0xE000E104;
	*NVIC_ISER1 |= (1 << 8);

// COPY
	uint32_t *VTOR = 0xE000ED08;
	*VTOR = 0x20000000;
	memcpy(0x20000000, 0x08000000, 304);
//set
	uint32_t *EXTI15_10_IRQHandler = 0x200000e0;
	*EXTI15_10_IRQHandler = my_interrupt;

	/* USER CODE END 2 */
	/* Infinite loop */
	while (1) {
		/* USER CODE BEGIN 3 */
		//FlashErase(0x08000000, 31);
		/*update_firmware();
		 */

	}
	/* USER CODE END 3 */
}

void SystemClock_Config(void) {
	RCC_OscInitTypeDef RCC_OscInitStruct = { 0 };
	RCC_ClkInitTypeDef RCC_ClkInitStruct = { 0 };

	/** Initializes the RCC Oscillators according to the specified parameters
	 * in the RCC_OscInitTypeDef structure.
	 */
	RCC_OscInitStruct.OscillatorType = RCC_OSCILLATORTYPE_HSI;
	RCC_OscInitStruct.HSIState = RCC_HSI_ON;
	RCC_OscInitStruct.HSICalibrationValue = RCC_HSICALIBRATION_DEFAULT;
	RCC_OscInitStruct.PLL.PLLState = RCC_PLL_NONE;
	if (HAL_RCC_OscConfig(&RCC_OscInitStruct) != HAL_OK) {
		Error_Handler();
	}
	/** Initializes the CPU, AHB and APB buses clocks
	 */
	RCC_ClkInitStruct.ClockType = RCC_CLOCKTYPE_HCLK | RCC_CLOCKTYPE_SYSCLK
			| RCC_CLOCKTYPE_PCLK1 | RCC_CLOCKTYPE_PCLK2;
	RCC_ClkInitStruct.SYSCLKSource = RCC_SYSCLKSOURCE_HSI;
	RCC_ClkInitStruct.AHBCLKDivider = RCC_SYSCLK_DIV1;
	RCC_ClkInitStruct.APB1CLKDivider = RCC_HCLK_DIV1;
	RCC_ClkInitStruct.APB2CLKDivider = RCC_HCLK_DIV1;

	if (HAL_RCC_ClockConfig(&RCC_ClkInitStruct, FLASH_LATENCY_0) != HAL_OK) {
		Error_Handler();
	}
}

static void MX_GPIO_Init(void) {

	/* GPIO Ports Clock Enable */
	__HAL_RCC_GPIOA_CLK_ENABLE();

}

/* USER CODE BEGIN 4 */

void my_interrupt() {
	uint32_t *EXTI_PR = 0x40010414;
	 *EXTI_PR |= (1 << 11);
	 GPIO_t *PORTB0 = 0x40010C00;
	 PORTB0->CRL &= ~(0xffffffff);
	 PORTB0->CRL |= (0b00110011);

	 PORTB0->ODR &= ~(0b1);

}
void delay(uint32_t time) {
	uint32_t timeout = time * 8000;
	for (int i = 0; i < timeout; i++) {
		__asm("NOP");
	}
}
/*void EXTI15_10_IRQHandler() {
	uint32_t *EXTI_PR = 0x40010414;
	*EXTI_PR |= (1 << 11);
	GPIO_t *PORTB0 = 0x40010C00;
	PORTB0->CRL &= ~(0xffffffff);
	PORTB0->CRL |= (0b00110011);

	PORTB0->ODR &= ~(0b1);
	delay(10);
	PORTB0->ODR |= (0b1);
	delay(10);

}*/

/* USER CODE END 4 */

void Error_Handler(void) {
	__disable_irq();
	while (1) {
	}
}

/************************ (C) COPYRIGHT STMicroelectronics *****END OF FILE****/
